## yocto/meta-rpi5os/conf/layer.conf
```bitbake
BBPATH .= ":${LAYERDIR}"
BBFILES += "${LAYERDIR}/recipes-*/*/*.bb ${LAYERDIR}/recipes-*/*/*.bbappend"

BBFILE_COLLECTIONS += "rpi5os"
BBFILE_PATTERN_rpi5os = "^${LAYERDIR}/"
BBFILE_PRIORITY_rpi5os = "10"

LAYERDEPENDS_rpi5os = "core raspberrypi"
LAYERSERIES_COMPAT_rpi5os = "wrynose"
```
